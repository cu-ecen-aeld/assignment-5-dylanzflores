## base_external/Config.in
```kconfig
# Include aesd-assignments (starter code)
source "../base_external/package/aesd-assignments/Config.in"

# Include ldd package
source "../base_external/package/ldd/Config.in"
```

## base_external/package/ldd/Config.in
```kconfig
config BR2_PACKAGE_LDD
    bool "ldd"
    help
      Linux Device Drivers modules from assignment 7.
```
